## boards/shields/pp/Kconfig.defconfig
```kconfig
if SHIELD_PP_LEFT

config ZMK_KEYBOARD_NAME
    default "PP"

config ZMK_SPLIT_ROLE_CENTRAL
    default y

endif

if SHIELD_PP_LEFT || SHIELD_PP_RIGHT

config ZMK_SPLIT
    default y

endif
```

## boards/shields/pp/Kconfig.shield
```kconfig
config SHIELD_PP_LEFT
    def_bool $(shields_list_contains,pp_left)

config SHIELD_PP_RIGHT
    def_bool $(shields_list_contains,pp_right)
```
